/*
 * Generated by MTK SP DrvGen Version 03.13.6 for MT6735M. Copyright MediaTek Inc. (C) 2013.
 * Mon Jul 04 23:47:54 2016
 * Do Not Modify the File.
 */

/**********************************************
 *Keypad DTSI File
********************************************/

&keypad {	
	KPD@ {
		compatible = "mediatek, kpd";
	};
};
